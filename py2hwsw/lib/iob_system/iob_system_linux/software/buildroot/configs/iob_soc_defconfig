## py2hwsw/lib/iob_system/iob_system_linux/software/buildroot/configs/iob_soc_defconfig
```kconfig
# SPDX-FileCopyrightText: 2026 IObundle
#
# SPDX-License-Identifier: GPL-3.0-only

## Build options
BR2_CCACHE=y
BR2_CCACHE_DIR="$(HOME)/.buildroot-ccache-saxon_default"

## Target options
BR2_riscv=y

## Instruction Set Extensions
BR2_riscv_custom=y
BR2_RISCV_ISA_RVM=y
BR2_RISCV_ISA_RVA=y
BR2_RISCV_ISA_RVC=y
BR2_RISCV_32=y
BR2_RISCV_ABI_ILP32=y

## Linux headers same as kernel
BR2_KERNEL_HEADERS_7_0=y

## System
BR2_TARGET_GENERIC_GETTY=y
BR2_TARGET_GENERIC_GETTY_PORT="console"
# Device Tree compilation is already handled by Makefile
#BR2_LINUX_KERNEL_DTS_SUPPORT=y
#BR2_LINUX_KERNEL_CUSTOM_DTS_PATH="$(BR2_EXTERNAL_IOB_SOC_PATH)/../iob_soc.dts"

## OpenSBI
BR2_TARGET_OPENSBI=n

## Kernel
BR2_LINUX_KERNEL=n

## Filesystem
BR2_TARGET_ROOTFS_CPIO=y
BR2_TARGET_ROOTFS_CPIO_GZIP=y
BR2_ROOTFS_DEVICE_CREATION_DYNAMIC_DEVTMPFS=y
BR2_ROOTFS_OVERLAY="$(BR2_EXTERNAL_IOB_SOC_PATH)/board/IObundle/iob-soc/rootfs-overlay"

## Extra packages
# Benchmark software
BR2_PACKAGE_DHRYSTONE=y
# To support python scripts under Linux
BR2_PACKAGE_MICROPYTHON=y
# To transfer files via UART
BR2_PACKAGE_LRZSZ=y
# To manage iob_eth core
BR2_PACKAGE_ETHTOOL=y
# SSH server for Linux
BR2_PACKAGE_DROPBEAR=y

# Set root user password to 'root'. Allows dropbear ssh connections to use root account
BR2_TARGET_GENERIC_PASSWD_SHA512=y
BR2_TARGET_GENERIC_ROOT_PASSWD="root"
```
