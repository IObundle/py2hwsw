// SPDX-FileCopyrightText: 2025 IObundle
//
// SPDX-License-Identifier: MIT


/dts-v1/;

/ {
    #address-cells = <1>;
    #size-cells = <1>;
    model = "IOb-SoC, VexRiscv";
    compatible = "IOb-SoC, VexRiscv";
    // CPU
    // Memory
    // Choosen
    soc {
        #address-cells = <1>;
        #size-cells = <1>;
        compatible = "iobundle,iob-soc", "simple-bus";
        ranges;

        // Other SOC peripherals go here

        // Add this Node to device tree
        TIMER0: timer@/*TIMER0_ADDR_MACRO*/ {
            compatible = "iobundle,timer0";
            reg = <0x/*TIMER0_ADDR_MACRO*/ 0x100>;
        };

    };
};
